BO_ 55 NEW_MSG_37: 8 XXX
 SG_ ACCELERATOR_PEDAL_RATE_OF_CHANGE : 6|15@0+ (1,0) [0|32767] "" XXX

BO_ 112 BUS1_SPEED: 8 XXX
 SG_ BUS1_SPEED : 23|16@0+ (0.01886,0) [0|65535] "m/s" XXX

BO_ 592 ECM_1: 8 XXX
 SG_ ACCELERATOR_PEDAL_POS : 31|8@0+ (1,0) [0|255] "" XXX

BO_ 832 BUS1_CRUISE_CONTROL: 8 XXX
 SG_ CRUISE_CONTROL_ENABLED : 56|1@0+ (1,0) [0|1] "" XXX
 SG_ CRUISE_CONTROL_ENABLED_IDLE_TRAFFIC : 57|1@0+ (1,0) [0|1] "" XXX

CM_ SG_ 592 ACCELERATOR_PEDAL_POS "Full gas ~200; Idle ~20";
